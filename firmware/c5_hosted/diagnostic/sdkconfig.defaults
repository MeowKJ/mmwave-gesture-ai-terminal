## firmware/p4_gesture/bringup/main/Kconfig.projbuild
```kconfig
config MEOAVE_C5_MAINT_HOST
    bool "Headless C5 app-only SDIO maintenance host"
    default n
    depends on ESP_HOSTED_ENABLED
```

## firmware/p4_gesture/bringup/sdkconfig.defaults
```kconfig
CONFIG_IDF_TARGET="esp32p4"
CONFIG_ESP32P4_REV_MIN_301=y
CONFIG_BOOTLOADER_LOG_LEVEL_WARN=y
CONFIG_ESPTOOLPY_FLASHMODE_DIO=y
CONFIG_ESPTOOLPY_FLASHFREQ_40M=y
CONFIG_ESPTOOLPY_FLASHSIZE_16MB=y
CONFIG_PARTITION_TABLE_CUSTOM=y
CONFIG_PARTITION_TABLE_CUSTOM_FILENAME="partitions.csv"
CONFIG_ESP_CONSOLE_UART_DEFAULT=y
CONFIG_ESP_CONSOLE_SECONDARY_NONE=y
CONFIG_ESP_MAIN_TASK_STACK_SIZE=8192
CONFIG_FREERTOS_HZ=1000
CONFIG_ESP_SYSTEM_USE_FRAME_POINTER=y
CONFIG_SPIRAM=n
CONFIG_COMPILER_OPTIMIZATION_PERF=y
```

## firmware/p4_gesture/main/Kconfig.projbuild
```kconfig
menu "Gesture Board Bring-up"

config APP_FLS2_OFFICIAL_BASELINE
    bool "Build the FLS2 official widgets demo with custom-board power/USB only"
    default n
    help
      Selects the checked-in OSPTEK-derived display source. Keep the audited
      panel and touch pipeline unchanged; the normal entry point is tools/meoave.py.

config APP_FLS2_AUTOTEST
    bool "Repeat FLS2 widgets / solid colors / hardware bars after power-on"
    depends on APP_FLS2_OFFICIAL_BASELINE && !APP_MEOAVE_UI
    default n
    help
      Diagnostic-only loop, approximately 44 seconds per round. USB commands
      LOOP OFF / LOOP ON pause and resume it. No repeated DCS reads, power
      cycling, panel reset, timing changes or automatic damage verdict.

config APP_MEOAVE_UI
    bool "Meoave light companion UI on the proven FLS2 pipeline"
    depends on APP_FLS2_OFFICIAL_BASELINE
    select LV_FONT_MONTSERRAT_26
    default n
    help
      Replaces only lv_demo_widgets with eyes, apps, settings and breathing.
      Keeps the audited panel/touch init and native USB recovery path.
      Use a separate build_meoave directory, never overwrite the baseline.

config APP_MEOAVE_WIFI_HOSTED
    bool "Enable ESP-Hosted Wi-Fi over the OSPTEK P4C5 SDIO bus"
    depends on APP_MEOAVE_UI
    default n
    help
      Links the pinned ESP-Hosted host component and exposes an explicit,
      non-blocking USB bring-up command. The default product build keeps this
      disabled until the C5 firmware and the shared GPIO54/radar startup
      timing have been verified. GPIO6 is deliberately not used: it remains
      available for the ES8389 I2S DOUT path.

config APP_C5_SDIO_LOADER
    bool "Manual-entry C5 SDIO programmer (embedded Hosted image)"
    depends on APP_MEOAVE_UI && !APP_MEOAVE_WIFI_HOSTED
    default n
    help
      Explicit USB commands only. Uses SDIO GPIO14-19; never drives GPIO6
      or C5 boot straps. Normal CONNECT never resets C5; explicit
      BOOTCONNECT resets shared GPIO54 once, with radar inactive and the
      user holding download straps. No automatic reset/retry fallback.
      Built separately using tools/meoave.py build --profile programmer.

config APP_COLOR_CYCLE_SEC
    int "Seconds per solid color in display self test"
    default 1
    range 1 30

config APP_AUDIO_BEEP
    bool "Play a 1 kHz beep at startup (enables PA)"
    default n

config APP_RADAR_HEXDUMP
    bool "Hex-dump radar UART data"
    default y

config APP_USB_HID_ENABLE
    bool "TinyUSB composite CDC + HID on USB_DM/DP"
    default y
    help
      CDC is the esptool flashing/console channel; HID is the gesture input
      device. The CDC line-state callback reboots the chip into ROM download
      mode so flashing needs no BOOT/EN button.

config APP_SELFTEST_COLORS
    bool "Run solid-color panel self test before LVGL UI"
    default y

config APP_AUDIO_CODEC_INIT
    bool "Program the ES8389 register tables at startup"
    default y
    help
      Writes the official Linux ES8389 init / power-on / unmute sequence.
      Turn this off if you only want bus probing and I2S clocks, e.g. when
      bringing up a new codec revision with an unverified register map.

config APP_USB_DOWNLOAD_ON_LONG_KEY
    bool "Hold power key 3 s to enter USB download mode (ON-only power key when off)"
    default n
    help
      OFF by default: the power key only powers the board on. This build has
      no long-press action and no software power-off.
      Enable only as a host-free fallback to re-enter ROM USB download mode.
      It disconnects USB and reboots the chip; with R13 pulling PWR_HOLD low,
      the reset window can brown out the 3V3 rail.

endmenu
```
