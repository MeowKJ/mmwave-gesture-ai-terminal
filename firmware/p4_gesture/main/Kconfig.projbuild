## firmware/p4_gesture/main/Kconfig.projbuild
```kconfig
menu "Gesture Board Bring-up"

config APP_FLS2_OFFICIAL_BASELINE
    bool "Use the audited FLS2 display/touch pipeline and custom-board power/USB"
    default n
    help
      Selects the checked-in OSPTEK-derived display source. Keep the audited
      panel and touch pipeline unchanged; the normal entry point is tools/meoave.py.

config APP_FLS2_AUTOTEST
    bool "Repeat FLS2 widgets / solid colors / hardware bars after power-on"
    depends on APP_FLS2_OFFICIAL_BASELINE && !APP_MEOAVE_UI
    default n
    help
      Diagnostic-only loop, approximately 44 seconds per round. USB commands
      LOOP OFF / LOOP ON pause and resume it. No repeated DCS reads, power
      cycling, panel reset, timing changes or automatic damage verdict.

config APP_MEOAVE_UI
    bool "Meoave light companion UI on the proven FLS2 pipeline"
    depends on APP_FLS2_OFFICIAL_BASELINE
    select LV_FONT_MONTSERRAT_26
    default n
    help
      Selects eyes, apps, settings and breathing on the audited display path.
      Keeps the audited panel/touch init and native USB recovery path.
      Use a separate build_meoave directory, never overwrite the baseline.

config APP_MEOAVE_WIFI_HOSTED
    bool "Enable ESP-Hosted Wi-Fi over the OSPTEK P4C5 SDIO bus"
    depends on APP_MEOAVE_UI
    default n
    help
      Links the pinned ESP-Hosted host component and exposes an explicit,
      non-blocking USB bring-up command. The default product build keeps this
      disabled until the C5 firmware and the shared GPIO54/radar startup
      timing have been verified. GPIO6 is deliberately not used: it remains
      available for the ES8389 I2S DOUT path.

config APP_MEOAVE_ESPSR
    bool "Enable ESP-SR local wake-word adapter"
    depends on APP_MEOAVE_UI
    default y
    help
      Adds the ESP32-P4 WakeNet adapter and the single-reader 48 kHz stereo
      to 16 kHz mono bridge. The official ESP-SR component is resolved only
      when MEOAVE_USE_ESP_SR=1. A custom WakeNet model for the Chinese keyword
      猫猫 is required; stock model names are never mislabeled as 猫猫.

config APP_MEOAVE_ESPSR_WAKE_MODEL
    string "ESP-SR WakeNet model name"
    depends on APP_MEOAVE_ESPSR
    default "wn9_maomao"
    help
      Name registered by the ESP-SR model asset. The product target is the
      custom Chinese wake word 猫猫, normally packaged as wn9_maomao. If the
      asset is absent or its metadata does not match 猫猫, the device reports
      MODEL_MISSING or MODEL_WORD_MISMATCH and remains fail-closed.

config APP_MEOAVE_ESPSR_MIC_CHANNEL
    int "Microphone channel used by ESP-SR"
    depends on APP_MEOAVE_ESPSR
    range 0 1
    default 0
    help
      Selects the already-calibrated ES8389 I2S channel used for WakeNet.

config APP_MEOAVE_ESPSR_WAKE_WORD
    string "Exact keyword expected in WakeNet metadata"
    depends on APP_MEOAVE_ESPSR
    default "猫猫"
    help
      Production target remains 猫猫. The explicit local diagnostic preset
      hi_miaomiao uses Hi,喵喵 with wn9_himiaomiao_tts only after consent.
      Never rename stock models or accept mismatched phrase metadata.

config APP_C5_NATIVE_MAINTENANCE
    bool "Native USB C5 maintenance on the custom board"
    depends on APP_MEOAVE_WIFI_HOSTED
    default n
    help
      Keeps the proven product UI/power/USB path. A dedicated worker reuses
      the headless host's app-only OTA and identity state machine. ATTACH
      never resets C5; CONNECT is explicit. GPIO6 modes and NET commands
      are rejected pending product audio/Wi-Fi integration.

config APP_C5_SDIO_LOADER
    bool "Manual-entry C5 SDIO programmer (embedded Hosted image)"
    depends on APP_MEOAVE_UI && !APP_MEOAVE_WIFI_HOSTED
    default n
    help
      Explicit USB commands only. Uses SDIO GPIO14-19; never drives GPIO6
      or C5 boot straps. Normal CONNECT never resets C5; explicit
      BOOTCONNECT resets shared GPIO54 once, with radar inactive and the
      user holding download straps. No automatic reset/retry fallback.
      Built separately using tools/meoave.py build --profile programmer.

config APP_USB_HID_ENABLE
    bool "TinyUSB composite CDC + HID on USB_DM/DP"
    default y
    help
      CDC is the esptool flashing/console channel; HID is the gesture input
      device. The CDC line-state callback reboots the chip into ROM download
      mode so flashing needs no BOOT/EN button.

config APP_AUDIO_CODEC_INIT
    bool "Program the ES8389 register tables at startup"
    default y
    help
      Writes the official Linux ES8389 init / power-on / unmute sequence.
      Turn this off if you only want bus probing and I2S clocks, e.g. when
      bringing up a new codec revision with an unverified register map.

endmenu
```
