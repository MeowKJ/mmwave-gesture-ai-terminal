/* Custom-board shell for the unmodified FLS2 display pipeline.
 * The official sample is generated by prepare_fls2_official.py; no gesture,
 * audio, radar or I2C scans run in this profile. The optional diagnostic loop
 * starts only after the official widgets pipeline has returned successfully.
 */
#include <stdio.h>
#include <string.h>

#include "board_pins.h"
#include "bsp_common.h"
#include "bsp_power.h"
#include "bsp_usb.h"
#include "fls2_touch_diag.h"
#include "fls2_display_diag.h"
#include "fls2_test_loop.h"
#include "sdkconfig.h"
#include "esp_log.h"
#include "esp_timer.h"
#include "freertos/FreeRTOS.h"
#include "freertos/task.h"

#ifdef CONFIG_APP_FLS2_AUTOTEST
#define FLS2_AUTO_BOOT 1
#else
#define FLS2_AUTO_BOOT 0
#endif

void fls2_official_demo(void);
static volatile bool s_demo_ready;
static volatile bool s_touch_report_requested;
static volatile bool s_display_report_requested;
static volatile bool s_quiet;
static fls2_test_loop_t s_test_loop;
static portMUX_TYPE s_loop_lock = portMUX_INITIALIZER_UNLOCKED;
static int s_loop_control; /* 0 unchanged, 1 on, 2 off */
static volatile bool s_loop_report_requested;
enum { MANUAL_NONE, MANUAL_NORMAL, MANUAL_BARS, MANUAL_COLORS, MANUAL_PROBE };
static int s_manual_display;

static void request_loop_control(int control, int manual)
{
    portENTER_CRITICAL(&s_loop_lock);
    s_loop_control = control;
    s_manual_display = manual;
    portEXIT_CRITICAL(&s_loop_lock);
}

static void report_loop(void)
{
    char line[192];
    snprintf(line, sizeof(line),
             "FLS2:LOOP enabled=%d round=%lu phase=%s boot_auto=%d "
             "dcs_probe=EXCLUDED reboot_required=%d\n",
             s_test_loop.enabled, (unsigned long)s_test_loop.round,
             fls2_test_loop_phase_name(s_test_loop.phase), FLS2_AUTO_BOOT,
             fls2_display_diag_needs_restart());
    (void)bsp_usb_cdc_write(line);
}

static void service_loop(void)
{
    portENTER_CRITICAL(&s_loop_lock);
    int control = s_loop_control, manual = s_manual_display;
    s_loop_control = 0;
    s_manual_display = MANUAL_NONE;
    portEXIT_CRITICAL(&s_loop_lock);
    if (control) {
        if (control == 1 && fls2_display_diag_needs_restart()) {
            (void)bsp_usb_cdc_write("FLS2:LOOP result=REJECTED reason=DCS_ENGINE_BUSY reboot_required=1\n");
        } else {
            fls2_test_loop_enable(&s_test_loop, control == 1);
            if (control == 2) {
                fls2_display_diag_cancel_colors();
                fls2_display_diag_request(false);
            }
        }
        s_loop_report_requested = true;
    }
    if (s_test_loop.enabled && fls2_display_diag_needs_restart()) {
        fls2_test_loop_enable(&s_test_loop, false);
        fls2_display_diag_cancel_colors();
        fls2_display_diag_request(false);
        (void)bsp_usb_cdc_write("FLS2:LOOP result=STOPPED reason=DCS_ENGINE_BUSY reboot_required=1\n");
        s_loop_report_requested = true;
    }
    /* All operations are scheduled by app_main, never blocked in USB callback.
       Manual visual/probe commands pause auto tests before taking ownership. */
    if (manual == MANUAL_NORMAL || manual == MANUAL_BARS) {
        fls2_display_diag_request(manual == MANUAL_BARS);
    } else if (manual == MANUAL_COLORS) {
        fls2_display_diag_request_colors();
    } else if (manual == MANUAL_PROBE) {
        fls2_display_diag_request_probe();
    }
    fls2_loop_phase_t previous_phase = s_test_loop.phase;
    uint32_t previous_round = s_test_loop.round;
    fls2_loop_action_t action = fls2_test_loop_step(&s_test_loop, s_demo_ready,
        fls2_display_diag_colors_active(), esp_timer_get_time());
    if (action == FLS2_LOOP_SHOW_WIDGETS) {
        if (previous_phase == FLS2_LOOP_BARS) {
            char line[192];
            snprintf(line, sizeof(line),
                     "FLS2:LOOP_END round=%lu result=SCHEDULE_DONE "
                     "visual=NOT_VERIFIED panel_damage=NOT_DETERMINED\n",
                     (unsigned long)previous_round);
            (void)bsp_usb_cdc_write(line);
            vTaskDelay(pdMS_TO_TICKS(10));
            fls2_display_diag_report();
        }
        fls2_display_diag_request(false);
        fls2_display_diag_request_hardware();
        s_loop_report_requested = true;
    } else if (action == FLS2_LOOP_SHOW_COLORS) {
        fls2_display_diag_request_colors();
        s_loop_report_requested = true;
    } else if (action == FLS2_LOOP_SHOW_BARS) {
        fls2_display_diag_request(true);
        s_loop_report_requested = true;
    } else if (action == FLS2_LOOP_ABORT) {
        (void)bsp_usb_cdc_write("FLS2:LOOP result=STOPPED reason=COLOR_RESTORE_TIMEOUT\n");
        fls2_display_diag_cancel_colors();
        fls2_display_diag_request(false);
        s_loop_report_requested = true;
    }
    if (s_loop_report_requested) {
        s_loop_report_requested = false;
        report_loop();
    }
}

static void report_status(void)
{
    char line[192];
    snprintf(line, sizeof(line),
             "FLS2:STATUS profile=official_widgets ready=%d usb=%d "
             "rgb888=1 lanes=1 mbps=500 dpi_mhz=16 vsync=NOT_MEASURED\n",
             s_demo_ready, bsp_usb_ready());
    (void)bsp_usb_cdc_write(line);
    (void)bsp_usb_cdc_write(
        "FLS2:DIFFERENCE dcs_id_read=SKIPPED_BY_EXISTING_LOCAL_PATCH "
        "panel_ack=NOT_VERIFIED\n");
}

static void on_command(const char *line, void *ctx)
{
    (void)ctx;
    if (strcmp(line, "PING") == 0) {
        char pong[96];
        snprintf(pong, sizeof(pong), "FLS2:PONG uptime_us=%lld\n",
                 (long long)esp_timer_get_time());
        (void)bsp_usb_cdc_write(pong);
    } else if (strcmp(line, "STATUS") == 0 || strcmp(line, "HELP") == 0) {
        report_status();
        s_touch_report_requested = true;
        s_loop_report_requested = true;
    } else if (strcmp(line, "LOOP ON") == 0 || strcmp(line, "LOOP OFF") == 0) {
        request_loop_control(strcmp(line, "LOOP ON") == 0 ? 1 : 2, MANUAL_NONE);
    } else if (strcmp(line, "LOOP") == 0) {
        s_loop_report_requested = true;
    } else if (strcmp(line, "TOUCH ON") == 0 || strcmp(line, "TOUCH OFF") == 0) {
        fls2_touch_diag_enable(strcmp(line, "TOUCH ON") == 0);
        s_touch_report_requested = true;
    } else if (strcmp(line, "TOUCH") == 0) {
        s_touch_report_requested = true;
    } else if (strcmp(line, "DISPLAY BARS") == 0 || strcmp(line, "DISPLAY NORMAL") == 0) {
        request_loop_control(2, strcmp(line, "DISPLAY BARS") == 0 ? MANUAL_BARS : MANUAL_NORMAL);
    } else if (strcmp(line, "DISPLAY") == 0) {
        s_display_report_requested = true;
    } else if (strcmp(line, "DISPLAY HW") == 0) {
        fls2_display_diag_request_hardware();
    } else if (strcmp(line, "DISPLAY PROBE") == 0) {
        request_loop_control(2, MANUAL_PROBE);
    } else if (strcmp(line, "DISPLAY COLORS") == 0) {
        request_loop_control(2, MANUAL_COLORS);
    } else if (strcmp(line, "REPORT QUIET") == 0) {
        s_quiet = true;
    } else if (strcmp(line, "REPORT NORMAL") == 0) {
        s_quiet = false;
    }
}

static void official_demo_task(void *ctx)
{
    (void)ctx;
    ESP_LOGW("FLS2", "official pipeline starting; existing ID-read skip is NOT stock behavior");
    fls2_official_demo();
    s_demo_ready = true;
    ESP_LOGI("FLS2", "official lv_demo_widgets created; visual confirmation still required");
    report_status();
    vTaskDelete(NULL);
}

void app_main(void)
{
    /* Keep the only recovery/download path available before panel setup. */
    bsp_power_init();
    fls2_test_loop_init(&s_test_loop, FLS2_AUTO_BOOT);
    ESP_ERROR_CHECK(bsp_usb_init());
    bsp_usb_set_line_callback(on_command, NULL);
    fls2_touch_diag_init();

    /* VCI_EN has a pull-up, as on the official adapter. Do not power-cycle it.
       GPIO12 is pulsed by the stock CO5300 reset implementation. */
    bsp_gpio_out(PIN_LCD_VCI_EN, 1);
    bsp_gpio_out(PIN_TP_RST, 0);
    vTaskDelay(pdMS_TO_TICKS(10));
    bsp_gpio_out(PIN_TP_RST, 1);
    vTaskDelay(pdMS_TO_TICKS(120));

    ESP_LOGI("FLS2", "build=%s %s; loop_at_boot=%d; audio/radar/custom UI/scans disabled",
             __DATE__, __TIME__, FLS2_AUTO_BOOT);
    BaseType_t ok = xTaskCreate(official_demo_task, "fls2_official", 10240, NULL, 1, NULL);
    ESP_ERROR_CHECK(ok == pdPASS ? ESP_OK : ESP_ERR_NO_MEM);
    /* No LVGL locks here: USB/heartbeat must not block on a stalled GUI task. */
    int64_t next_report_us = 0;
    int64_t next_touch_live_us = 0;
    while (true) {
        vTaskDelay(pdMS_TO_TICKS(20));
        fls2_touch_diag_service();
        service_loop();
        if (s_demo_ready) fls2_display_diag_service();
        if (s_display_report_requested) {
            s_display_report_requested = false;
            fls2_display_diag_report();
        }
        int64_t now = esp_timer_get_time();
        if (now >= next_report_us) {
            next_report_us = now + 2000000;
            if (!s_quiet) {
                report_status();
                if (!s_test_loop.enabled) s_touch_report_requested = true;
            }
        }
        if (!s_quiet && s_demo_ready && s_test_loop.enabled && now >= next_touch_live_us) {
            next_touch_live_us = now + 200000;
            fls2_touch_diag_report_compact();
        }
        if (s_touch_report_requested) {
            s_touch_report_requested = false;
            fls2_touch_diag_report();
        }
    }
}
